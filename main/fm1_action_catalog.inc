/* Compiled firmware action descriptors. */
static const fm1_action_field_t fields_0[] = {
{"轨道 (0–3)",0,3,0,0,7,0,0,0},
{"电平",0,127,100,1,14,0,8192,1},
{"静音",0,1,0,3,7,0,0,3},
};
static const fm1_action_field_t fields_1[] = {
{"轨道 (0–3)",0,3,0,0,7,0,0,0},
{"步进 (0–63)",0,63,0,1,7,0,0,1},
{"音符数量",0,4,1,2,7,0,0,2},
{"音符 1",0,127,60,3,7,0,0,3},
{"音符 2",0,127,60,4,7,0,0,4},
{"音符 3",0,127,60,5,7,0,0,5},
{"音符 4",0,127,60,6,7,0,0,6},
{"时值 · 0音符 1延音 2休止",0,2,0,7,7,0,0,7},
{"重音",0,1,0,8,1,0,0,8},
{"滑音",0,1,0,8,1,1,0,8},
{"力度",1,127,96,9,7,0,0,9},
{"鼓击 1",0,1,0,10,1,0,0,10},
{"鼓击 2",0,1,0,10,1,1,0,10},
{"鼓击 3",0,1,0,10,1,2,0,10},
{"鼓击 4",0,1,0,10,1,3,0,10},
{"鼓击 5",0,1,0,10,1,4,0,10},
{"鼓击 6",0,1,0,10,1,5,0,10},
{"鼓击 7",0,1,0,10,1,6,0,10},
{"鼓击 8",0,1,0,12,1,0,0,12},
{"鼓重音 1",0,1,0,11,1,0,0,11},
{"鼓重音 2",0,1,0,11,1,1,0,11},
{"鼓重音 3",0,1,0,11,1,2,0,11},
{"鼓重音 4",0,1,0,11,1,3,0,11},
{"鼓重音 5",0,1,0,11,1,4,0,11},
{"鼓重音 6",0,1,0,11,1,5,0,11},
{"鼓重音 7",0,1,0,11,1,6,0,11},
{"鼓重音 8",0,1,0,12,1,1,0,12},
{"概率 %",0,100,100,13,7,0,0,13},
{"连击次数",1,4,1,14,7,0,0,14},
{"微时序",-8,7,0,15,7,0,8,15},
{"条件 · 0无 1–9循环 10填充 11非填充",0,11,0,16,7,0,0,16},
};
static const fm1_action_field_t fields_2[] = {
{"轨道 (0–3)",0,3,0,0,7,0,0,0},
{"电平",0,127,100,1,14,0,8192,1},
{"静音",0,1,0,3,7,0,0,3},
};
static const fm1_action_field_t fields_3[] = {
{"轨道 (0–3)",0,3,0,0,7,0,0,0},
{"步进 (0–63)",0,63,0,1,7,0,0,1},
{"音符数量",0,4,1,2,7,0,0,2},
{"音符 1",0,127,60,3,7,0,0,3},
{"音符 2",0,127,60,4,7,0,0,4},
{"音符 3",0,127,60,5,7,0,0,5},
{"音符 4",0,127,60,6,7,0,0,6},
{"时值 · 0音符 1延音 2休止",0,2,0,7,7,0,0,7},
{"重音",0,1,0,8,1,0,0,8},
{"滑音",0,1,0,8,1,1,0,8},
{"力度",1,127,96,9,7,0,0,9},
{"音符 1 电平 · 0正常 1幽灵 2轻 3重",0,3,0,10,2,0,0,10},
{"音符 2 电平 · 0正常 1幽灵 2轻 3重",0,3,0,10,2,2,0,10},
{"音符 3 电平 · 0正常 1幽灵 2轻 3重",0,3,0,10,2,4,0,10},
{"音符 4 电平",0,3,0,10,2,6,0,10},
{"音符 1 连击 · 0–3 = 1–4次",0,3,0,12,2,0,0,12},
{"音符 2 连击 · 0–3 = 1–4次",0,3,0,12,2,2,0,12},
{"音符 3 连击 · 0–3 = 1–4次",0,3,0,12,2,4,0,12},
{"音符 4 连击 · 0–3 = 1–4次",0,3,0,12,2,6,0,12},
};
static const fm1_action_field_t fields_4[] = {
{"轨道 (0–3)",0,3,0,0,7,0,0,0},
{"电平",0,127,100,1,14,0,8192,1},
{"静音",0,1,0,3,7,0,0,3},
};
static const fm1_action_field_t fields_5[] = {
{"轨道 (0–3)",0,3,0,0,7,0,0,0},
{"步进 (0–63)",0,63,0,1,7,0,0,1},
{"音符数量",0,4,1,2,7,0,0,2},
{"音符 1",0,127,60,3,7,0,0,3},
{"音符 2",0,127,60,4,7,0,0,4},
{"音符 3",0,127,60,5,7,0,0,5},
{"音符 4",0,127,60,6,7,0,0,6},
{"时值 · 0音符 1延音 2休止",0,2,0,7,7,0,0,7},
{"重音",0,1,0,8,1,0,0,8},
{"滑音",0,1,0,8,1,1,0,8},
{"力度",1,127,96,9,7,0,0,9},
};
static const fm1_action_field_t fields_6[] = {
{"引擎",0,31,0,0,7,0,0,0},
{"预设",0,127,0,1,7,0,0,1},
};
static const fm1_action_field_t fields_7[] = {
{"引擎",0,31,0,0,7,0,0,-1},
};
static const fm1_action_field_t fields_8[] = {
{"起始槽位",0,31,0,0,7,0,0,-1},
{"数量",1,16,16,1,7,0,0,-1},
};
static const fm1_action_field_t fields_9[] = {
{"用户槽位",0,31,0,0,7,0,0,0},
};
static const fm1_action_field_t fields_10[] = {
{"用户槽位",0,31,0,0,7,0,0,0},
};
static const fm1_action_field_t fields_11[] = {
{"用户槽位",0,31,0,0,7,0,0,0},
{"名称字符 1 (ASCII)",32,126,77,1,7,0,0,-1},
{"名称字符 2 (ASCII)",32,126,49,2,7,0,0,-1},
{"名称字符 3 (ASCII)",32,126,78,3,7,0,0,-1},
{"名称字符 4 (ASCII)",32,126,49,4,7,0,0,-1},
{"名称字符 5 (ASCII)",32,126,76,5,7,0,0,-1},
{"名称字符 6 (ASCII)",32,126,69,6,7,0,0,-1},
{"名称字符 7 (ASCII)",32,126,53,7,7,0,0,-1},
{"名称字符 8 (ASCII)",32,126,53,8,7,0,0,-1},
{"名称字符 9 (ASCII)",32,126,32,9,7,0,0,-1},
{"名称字符 10 (ASCII)",32,126,32,10,7,0,0,-1},
{"名称字符 11 (ASCII)",32,126,32,11,7,0,0,-1},
{"名称字符 12 (ASCII)",32,126,32,12,7,0,0,-1},
};
static const fm1_action_field_t fields_12[] = {
{.name=""},
};
static const fm1_action_field_t fields_13[] = {
{"库槽位",0,26,0,0,7,0,0,0},
};
static const fm1_action_field_t fields_14[] = {
{"库槽位",0,63,0,0,7,0,0,0},
};
static const fm1_action_field_t fields_15[] = {
{.name=""},
};
static const fm1_action_field_t fields_16[] = {
{.name=""},
};
static const fm1_action_field_t fields_17[] = {
{.name=""},
};
static const fm1_action_field_t fields_18[] = {
{"目标 · 0轨道 2工厂 3用户",0,3,0,0,7,0,0,0},
{"槽位",0,31,0,1,7,0,0,1},
{"OP6 包络速度 R1",0,99,0,2,7,0,0,3},
{"OP6 包络速度 R2",0,99,0,3,7,0,0,4},
{"OP6 包络速度 R3",0,99,0,4,7,0,0,5},
{"OP6 包络速度 R4",0,99,0,5,7,0,0,6},
{"OP6 包络电平 L1",0,99,0,6,7,0,0,7},
{"OP6 包络电平 L2",0,99,0,7,7,0,0,8},
{"OP6 包络电平 L3",0,99,0,8,7,0,0,9},
{"OP6 包络电平 L4",0,99,0,9,7,0,0,10},
{"OP6 断点",0,99,0,10,7,0,0,11},
{"OP6 左深度",0,99,0,11,7,0,0,12},
{"OP6 右深度",0,99,0,12,7,0,0,13},
{"OP6 左曲线",0,3,0,13,2,0,0,14},
{"OP6 右曲线",0,3,0,13,2,2,0,14},
{"OP6 速度缩放",0,7,0,14,3,0,0,15},
{"OP6 微调",0,14,7,14,4,3,0,15},
{"OP6 振幅灵敏度",0,3,0,15,2,0,0,16},
{"OP6 力度灵敏度",0,7,0,15,3,2,0,16},
{"OP6 输出",0,99,99,16,7,0,0,17},
{"OP6 频率模式",0,1,0,17,1,0,0,18},
{"OP6 粗调",0,31,1,17,5,1,0,18},
{"OP6 细调",0,99,0,18,7,0,0,19},
{"OP5 包络速度 R1",0,99,0,19,7,0,0,20},
{"OP5 包络速度 R2",0,99,0,20,7,0,0,21},
{"OP5 包络速度 R3",0,99,0,21,7,0,0,22},
{"OP5 包络速度 R4",0,99,0,22,7,0,0,23},
{"OP5 包络电平 L1",0,99,0,23,7,0,0,24},
{"OP5 包络电平 L2",0,99,0,24,7,0,0,25},
{"OP5 包络电平 L3",0,99,0,25,7,0,0,26},
{"OP5 包络电平 L4",0,99,0,26,7,0,0,27},
{"OP5 断点",0,99,0,27,7,0,0,28},
{"OP5 左深度",0,99,0,28,7,0,0,29},
{"OP5 右深度",0,99,0,29,7,0,0,30},
{"OP5 左曲线",0,3,0,30,2,0,0,31},
{"OP5 右曲线",0,3,0,30,2,2,0,31},
{"OP5 速度缩放",0,7,0,31,3,0,0,32},
{"OP5 微调",0,14,7,31,4,3,0,32},
{"OP5 振幅灵敏度",0,3,0,32,2,0,0,33},
{"OP5 力度灵敏度",0,7,0,32,3,2,0,33},
{"OP5 输出",0,99,99,33,7,0,0,34},
{"OP5 频率模式",0,1,0,34,1,0,0,35},
{"OP5 粗调",0,31,1,34,5,1,0,35},
{"OP5 细调",0,99,0,35,7,0,0,36},
{"OP4 包络速度 R1",0,99,0,36,7,0,0,37},
{"OP4 包络速度 R2",0,99,0,37,7,0,0,38},
{"OP4 包络速度 R3",0,99,0,38,7,0,0,39},
{"OP4 包络速度 R4",0,99,0,39,7,0,0,40},
{"OP4 包络电平 L1",0,99,0,40,7,0,0,41},
{"OP4 包络电平 L2",0,99,0,41,7,0,0,42},
{"OP4 包络电平 L3",0,99,0,42,7,0,0,43},
{"OP4 包络电平 L4",0,99,0,43,7,0,0,44},
{"OP4 断点",0,99,0,44,7,0,0,45},
{"OP4 左深度",0,99,0,45,7,0,0,46},
{"OP4 右深度",0,99,0,46,7,0,0,47},
{"OP4 左曲线",0,3,0,47,2,0,0,48},
{"OP4 右曲线",0,3,0,47,2,2,0,48},
{"OP4 速度缩放",0,7,0,48,3,0,0,49},
{"OP4 微调",0,14,7,48,4,3,0,49},
{"OP4 振幅灵敏度",0,3,0,49,2,0,0,50},
{"OP4 力度灵敏度",0,7,0,49,3,2,0,50},
{"OP4 输出",0,99,99,50,7,0,0,51},
{"OP4 频率模式",0,1,0,51,1,0,0,52},
{"OP4 粗调",0,31,1,51,5,1,0,52},
{"OP4 细调",0,99,0,52,7,0,0,53},
{"OP3 包络速度 R1",0,99,0,53,7,0,0,54},
{"OP3 包络速度 R2",0,99,0,54,7,0,0,55},
{"OP3 包络速度 R3",0,99,0,55,7,0,0,56},
{"OP3 包络速度 R4",0,99,0,56,7,0,0,57},
{"OP3 包络电平 L1",0,99,0,57,7,0,0,58},
{"OP3 包络电平 L2",0,99,0,58,7,0,0,59},
{"OP3 包络电平 L3",0,99,0,59,7,0,0,60},
{"OP3 包络电平 L4",0,99,0,60,7,0,0,61},
{"OP3 断点",0,99,0,61,7,0,0,62},
{"OP3 左深度",0,99,0,62,7,0,0,63},
{"OP3 右深度",0,99,0,63,7,0,0,64},
{"OP3 左曲线",0,3,0,64,2,0,0,65},
{"OP3 右曲线",0,3,0,64,2,2,0,65},
{"OP3 速度缩放",0,7,0,65,3,0,0,66},
{"OP3 微调",0,14,7,65,4,3,0,66},
{"OP3 振幅灵敏度",0,3,0,66,2,0,0,67},
{"OP3 力度灵敏度",0,7,0,66,3,2,0,67},
{"OP3 输出",0,99,99,67,7,0,0,68},
{"OP3 频率模式",0,1,0,68,1,0,0,69},
{"OP3 粗调",0,31,1,68,5,1,0,69},
{"OP3 细调",0,99,0,69,7,0,0,70},
{"OP2 包络速度 R1",0,99,0,70,7,0,0,71},
{"OP2 包络速度 R2",0,99,0,71,7,0,0,72},
{"OP2 包络速度 R3",0,99,0,72,7,0,0,73},
{"OP2 包络速度 R4",0,99,0,73,7,0,0,74},
{"OP2 包络电平 L1",0,99,0,74,7,0,0,75},
{"OP2 包络电平 L2",0,99,0,75,7,0,0,76},
{"OP2 包络电平 L3",0,99,0,76,7,0,0,77},
{"OP2 包络电平 L4",0,99,0,77,7,0,0,78},
{"OP2 断点",0,99,0,78,7,0,0,79},
{"OP2 左深度",0,99,0,79,7,0,0,80},
{"OP2 右深度",0,99,0,80,7,0,0,81},
{"OP2 左曲线",0,3,0,81,2,0,0,82},
{"OP2 右曲线",0,3,0,81,2,2,0,82},
{"OP2 速度缩放",0,7,0,82,3,0,0,83},
{"OP2 微调",0,14,7,82,4,3,0,83},
{"OP2 振幅灵敏度",0,3,0,83,2,0,0,84},
{"OP2 力度灵敏度",0,7,0,83,3,2,0,84},
{"OP2 输出",0,99,99,84,7,0,0,85},
{"OP2 频率模式",0,1,0,85,1,0,0,86},
{"OP2 粗调",0,31,1,85,5,1,0,86},
{"OP2 细调",0,99,0,86,7,0,0,87},
{"OP1 包络速度 R1",0,99,0,87,7,0,0,88},
{"OP1 包络速度 R2",0,99,0,88,7,0,0,89},
{"OP1 包络速度 R3",0,99,0,89,7,0,0,90},
{"OP1 包络速度 R4",0,99,0,90,7,0,0,91},
{"OP1 包络电平 L1",0,99,0,91,7,0,0,92},
{"OP1 包络电平 L2",0,99,0,92,7,0,0,93},
{"OP1 包络电平 L3",0,99,0,93,7,0,0,94},
{"OP1 包络电平 L4",0,99,0,94,7,0,0,95},
{"OP1 断点",0,99,0,95,7,0,0,96},
{"OP1 左深度",0,99,0,96,7,0,0,97},
{"OP1 右深度",0,99,0,97,7,0,0,98},
{"OP1 左曲线",0,3,0,98,2,0,0,99},
{"OP1 右曲线",0,3,0,98,2,2,0,99},
{"OP1 速度缩放",0,7,0,99,3,0,0,100},
{"OP1 微调",0,14,7,99,4,3,0,100},
{"OP1 振幅灵敏度",0,3,0,100,2,0,0,101},
{"OP1 力度灵敏度",0,7,0,100,3,2,0,101},
{"OP1 输出",0,99,99,101,7,0,0,102},
{"OP1 频率模式",0,1,0,102,1,0,0,103},
{"OP1 粗调",0,31,1,102,5,1,0,103},
{"OP1 细调",0,99,0,103,7,0,0,104},
{"音高包络 R1",0,99,0,104,7,0,0,105},
{"音高包络 R2",0,99,0,105,7,0,0,106},
{"音高包络 R3",0,99,0,106,7,0,0,107},
{"音高包络 R4",0,99,0,107,7,0,0,108},
{"音高包络 L1",0,99,0,108,7,0,0,109},
{"音高包络 L2",0,99,0,109,7,0,0,110},
{"音高包络 L3",0,99,0,110,7,0,0,111},
{"音高包络 L4",0,99,0,111,7,0,0,112},
{"算法",0,31,0,112,5,0,0,113},
{"反馈",0,7,0,113,3,0,0,114},
{"振荡器同步",0,1,0,113,1,3,0,114},
{"LFO 速度",0,99,0,114,7,0,0,115},
{"LFO 延迟",0,99,0,115,7,0,0,116},
{"LFO 音高深度",0,99,0,116,7,0,0,117},
{"LFO 振幅深度",0,99,0,117,7,0,0,118},
{"LFO 同步",0,1,0,118,1,0,0,119},
{"LFO 波形",0,5,0,118,3,1,0,119},
{"音高灵敏度",0,7,0,118,3,4,0,119},
{"移调",0,48,24,119,7,0,0,120},
{"名称字符 1 (ASCII)",32,126,32,120,7,0,0,121},
{"名称字符 2 (ASCII)",32,126,32,121,7,0,0,122},
{"名称字符 3 (ASCII)",32,126,32,122,7,0,0,123},
{"名称字符 4 (ASCII)",32,126,32,123,7,0,0,124},
{"名称字符 5 (ASCII)",32,126,32,124,7,0,0,125},
{"名称字符 6 (ASCII)",32,126,32,125,7,0,0,126},
{"名称字符 7 (ASCII)",32,126,32,126,7,0,0,127},
{"名称字符 8 (ASCII)",32,126,32,127,7,0,0,128},
{"名称字符 9 (ASCII)",32,126,32,128,7,0,0,129},
{"名称字符 10 (ASCII)",32,126,32,129,7,0,0,130},
};
static const fm1_action_field_t fields_19[] = {
{"目标 · 0轨道 1库 2工厂(只读)",0,2,0,0,7,0,0,0},
{"槽位",0,26,0,1,7,0,0,1},
{"OP6 包络速度 R1",0,99,0,2,7,0,0,3},
{"OP6 包络速度 R2",0,99,0,3,7,0,0,4},
{"OP6 包络速度 R3",0,99,0,4,7,0,0,5},
{"OP6 包络速度 R4",0,99,0,5,7,0,0,6},
{"OP6 包络电平 L1",0,99,0,6,7,0,0,7},
{"OP6 包络电平 L2",0,99,0,7,7,0,0,8},
{"OP6 包络电平 L3",0,99,0,8,7,0,0,9},
{"OP6 包络电平 L4",0,99,0,9,7,0,0,10},
{"OP6 断点",0,99,0,10,7,0,0,11},
{"OP6 左深度",0,99,0,11,7,0,0,12},
{"OP6 右深度",0,99,0,12,7,0,0,13},
{"OP6 左曲线",0,3,0,13,2,0,0,14},
{"OP6 右曲线",0,3,0,13,2,2,0,14},
{"OP6 速度缩放",0,7,0,14,3,0,0,15},
{"OP6 微调",0,14,7,14,4,3,0,15},
{"OP6 振幅灵敏度",0,3,0,15,2,0,0,16},
{"OP6 力度灵敏度",0,7,0,15,3,2,0,16},
{"OP6 输出",0,99,99,16,7,0,0,17},
{"OP6 频率模式",0,1,0,17,1,0,0,18},
{"OP6 粗调",0,31,1,17,5,1,0,18},
{"OP6 细调",0,99,0,18,7,0,0,19},
{"OP5 包络速度 R1",0,99,0,19,7,0,0,20},
{"OP5 包络速度 R2",0,99,0,20,7,0,0,21},
{"OP5 包络速度 R3",0,99,0,21,7,0,0,22},
{"OP5 包络速度 R4",0,99,0,22,7,0,0,23},
{"OP5 包络电平 L1",0,99,0,23,7,0,0,24},
{"OP5 包络电平 L2",0,99,0,24,7,0,0,25},
{"OP5 包络电平 L3",0,99,0,25,7,0,0,26},
{"OP5 包络电平 L4",0,99,0,26,7,0,0,27},
{"OP5 断点",0,99,0,27,7,0,0,28},
{"OP5 左深度",0,99,0,28,7,0,0,29},
{"OP5 右深度",0,99,0,29,7,0,0,30},
{"OP5 左曲线",0,3,0,30,2,0,0,31},
{"OP5 右曲线",0,3,0,30,2,2,0,31},
{"OP5 速度缩放",0,7,0,31,3,0,0,32},
{"OP5 微调",0,14,7,31,4,3,0,32},
{"OP5 振幅灵敏度",0,3,0,32,2,0,0,33},
{"OP5 力度灵敏度",0,7,0,32,3,2,0,33},
{"OP5 输出",0,99,99,33,7,0,0,34},
{"OP5 频率模式",0,1,0,34,1,0,0,35},
{"OP5 粗调",0,31,1,34,5,1,0,35},
{"OP5 细调",0,99,0,35,7,0,0,36},
{"OP4 包络速度 R1",0,99,0,36,7,0,0,37},
{"OP4 包络速度 R2",0,99,0,37,7,0,0,38},
{"OP4 包络速度 R3",0,99,0,38,7,0,0,39},
{"OP4 包络速度 R4",0,99,0,39,7,0,0,40},
{"OP4 包络电平 L1",0,99,0,40,7,0,0,41},
{"OP4 包络电平 L2",0,99,0,41,7,0,0,42},
{"OP4 包络电平 L3",0,99,0,42,7,0,0,43},
{"OP4 包络电平 L4",0,99,0,43,7,0,0,44},
{"OP4 断点",0,99,0,44,7,0,0,45},
{"OP4 左深度",0,99,0,45,7,0,0,46},
{"OP4 右深度",0,99,0,46,7,0,0,47},
{"OP4 左曲线",0,3,0,47,2,0,0,48},
{"OP4 右曲线",0,3,0,47,2,2,0,48},
{"OP4 速度缩放",0,7,0,48,3,0,0,49},
{"OP4 微调",0,14,7,48,4,3,0,49},
{"OP4 振幅灵敏度",0,3,0,49,2,0,0,50},
{"OP4 力度灵敏度",0,7,0,49,3,2,0,50},
{"OP4 输出",0,99,99,50,7,0,0,51},
{"OP4 频率模式",0,1,0,51,1,0,0,52},
{"OP4 粗调",0,31,1,51,5,1,0,52},
{"OP4 细调",0,99,0,52,7,0,0,53},
{"OP3 包络速度 R1",0,99,0,53,7,0,0,54},
{"OP3 包络速度 R2",0,99,0,54,7,0,0,55},
{"OP3 包络速度 R3",0,99,0,55,7,0,0,56},
{"OP3 包络速度 R4",0,99,0,56,7,0,0,57},
{"OP3 包络电平 L1",0,99,0,57,7,0,0,58},
{"OP3 包络电平 L2",0,99,0,58,7,0,0,59},
{"OP3 包络电平 L3",0,99,0,59,7,0,0,60},
{"OP3 包络电平 L4",0,99,0,60,7,0,0,61},
{"OP3 断点",0,99,0,61,7,0,0,62},
{"OP3 左深度",0,99,0,62,7,0,0,63},
{"OP3 右深度",0,99,0,63,7,0,0,64},
{"OP3 左曲线",0,3,0,64,2,0,0,65},
{"OP3 右曲线",0,3,0,64,2,2,0,65},
{"OP3 速度缩放",0,7,0,65,3,0,0,66},
{"OP3 微调",0,14,7,65,4,3,0,66},
{"OP3 振幅灵敏度",0,3,0,66,2,0,0,67},
{"OP3 力度灵敏度",0,7,0,66,3,2,0,67},
{"OP3 输出",0,99,99,67,7,0,0,68},
{"OP3 频率模式",0,1,0,68,1,0,0,69},
{"OP3 粗调",0,31,1,68,5,1,0,69},
{"OP3 细调",0,99,0,69,7,0,0,70},
{"OP2 包络速度 R1",0,99,0,70,7,0,0,71},
{"OP2 包络速度 R2",0,99,0,71,7,0,0,72},
{"OP2 包络速度 R3",0,99,0,72,7,0,0,73},
{"OP2 包络速度 R4",0,99,0,73,7,0,0,74},
{"OP2 包络电平 L1",0,99,0,74,7,0,0,75},
{"OP2 包络电平 L2",0,99,0,75,7,0,0,76},
{"OP2 包络电平 L3",0,99,0,76,7,0,0,77},
{"OP2 包络电平 L4",0,99,0,77,7,0,0,78},
{"OP2 断点",0,99,0,78,7,0,0,79},
{"OP2 左深度",0,99,0,79,7,0,0,80},
{"OP2 右深度",0,99,0,80,7,0,0,81},
{"OP2 左曲线",0,3,0,81,2,0,0,82},
{"OP2 右曲线",0,3,0,81,2,2,0,82},
{"OP2 速度缩放",0,7,0,82,3,0,0,83},
{"OP2 微调",0,14,7,82,4,3,0,83},
{"OP2 振幅灵敏度",0,3,0,83,2,0,0,84},
{"OP2 力度灵敏度",0,7,0,83,3,2,0,84},
{"OP2 输出",0,99,99,84,7,0,0,85},
{"OP2 频率模式",0,1,0,85,1,0,0,86},
{"OP2 粗调",0,31,1,85,5,1,0,86},
{"OP2 细调",0,99,0,86,7,0,0,87},
{"OP1 包络速度 R1",0,99,0,87,7,0,0,88},
{"OP1 包络速度 R2",0,99,0,88,7,0,0,89},
{"OP1 包络速度 R3",0,99,0,89,7,0,0,90},
{"OP1 包络速度 R4",0,99,0,90,7,0,0,91},
{"OP1 包络电平 L1",0,99,0,91,7,0,0,92},
{"OP1 包络电平 L2",0,99,0,92,7,0,0,93},
{"OP1 包络电平 L3",0,99,0,93,7,0,0,94},
{"OP1 包络电平 L4",0,99,0,94,7,0,0,95},
{"OP1 断点",0,99,0,95,7,0,0,96},
{"OP1 左深度",0,99,0,96,7,0,0,97},
{"OP1 右深度",0,99,0,97,7,0,0,98},
{"OP1 左曲线",0,3,0,98,2,0,0,99},
{"OP1 右曲线",0,3,0,98,2,2,0,99},
{"OP1 速度缩放",0,7,0,99,3,0,0,100},
{"OP1 微调",0,14,7,99,4,3,0,100},
{"OP1 振幅灵敏度",0,3,0,100,2,0,0,101},
{"OP1 力度灵敏度",0,7,0,100,3,2,0,101},
{"OP1 输出",0,99,99,101,7,0,0,102},
{"OP1 频率模式",0,1,0,102,1,0,0,103},
{"OP1 粗调",0,31,1,102,5,1,0,103},
{"OP1 细调",0,99,0,103,7,0,0,104},
{"音高包络 R1",0,99,0,104,7,0,0,105},
{"音高包络 R2",0,99,0,105,7,0,0,106},
{"音高包络 R3",0,99,0,106,7,0,0,107},
{"音高包络 R4",0,99,0,107,7,0,0,108},
{"音高包络 L1",0,99,0,108,7,0,0,109},
{"音高包络 L2",0,99,0,109,7,0,0,110},
{"音高包络 L3",0,99,0,110,7,0,0,111},
{"音高包络 L4",0,99,0,111,7,0,0,112},
{"算法",0,31,0,112,5,0,0,113},
{"反馈",0,7,0,113,3,0,0,114},
{"振荡器同步",0,1,0,113,1,3,0,114},
{"LFO 速度",0,99,0,114,7,0,0,115},
{"LFO 延迟",0,99,0,115,7,0,0,116},
{"LFO 音高深度",0,99,0,116,7,0,0,117},
{"LFO 振幅深度",0,99,0,117,7,0,0,118},
{"LFO 同步",0,1,0,118,1,0,0,119},
{"LFO 波形",0,5,0,118,3,1,0,119},
{"音高灵敏度",0,7,0,118,3,4,0,119},
{"移调",0,48,24,119,7,0,0,120},
{"名称字符 1 (ASCII)",32,126,32,120,7,0,0,121},
{"名称字符 2 (ASCII)",32,126,32,121,7,0,0,122},
{"名称字符 3 (ASCII)",32,126,32,122,7,0,0,123},
{"名称字符 4 (ASCII)",32,126,32,123,7,0,0,124},
{"名称字符 5 (ASCII)",32,126,32,124,7,0,0,125},
{"名称字符 6 (ASCII)",32,126,32,125,7,0,0,126},
{"名称字符 7 (ASCII)",32,126,32,126,7,0,0,127},
{"名称字符 8 (ASCII)",32,126,32,127,7,0,0,128},
{"名称字符 9 (ASCII)",32,126,32,128,7,0,0,129},
{"名称字符 10 (ASCII)",32,126,32,129,7,0,0,130},
};
static const fm1_action_field_t fields_20[] = {
{"目标 · 0轨道 1库 2工厂(只读)",0,2,0,0,7,0,0,0},
{"槽位",0,63,0,1,7,0,0,1},
{"OP6 包络速度 R1",0,99,0,2,7,0,0,3},
{"OP6 包络速度 R2",0,99,0,3,7,0,0,4},
{"OP6 包络速度 R3",0,99,0,4,7,0,0,5},
{"OP6 包络速度 R4",0,99,0,5,7,0,0,6},
{"OP6 包络电平 L1",0,99,0,6,7,0,0,7},
{"OP6 包络电平 L2",0,99,0,7,7,0,0,8},
{"OP6 包络电平 L3",0,99,0,8,7,0,0,9},
{"OP6 包络电平 L4",0,99,0,9,7,0,0,10},
{"OP6 断点",0,99,0,10,7,0,0,11},
{"OP6 左深度",0,99,0,11,7,0,0,12},
{"OP6 右深度",0,99,0,12,7,0,0,13},
{"OP6 左曲线",0,3,0,13,2,0,0,14},
{"OP6 右曲线",0,3,0,13,2,2,0,14},
{"OP6 速度缩放",0,7,0,14,3,0,0,15},
{"OP6 微调",0,14,7,14,4,3,0,15},
{"OP6 振幅灵敏度",0,3,0,15,2,0,0,16},
{"OP6 力度灵敏度",0,7,0,15,3,2,0,16},
{"OP6 输出",0,99,99,16,7,0,0,17},
{"OP6 频率模式",0,1,0,17,1,0,0,18},
{"OP6 粗调",0,31,1,17,5,1,0,18},
{"OP6 细调",0,99,0,18,7,0,0,19},
{"OP5 包络速度 R1",0,99,0,19,7,0,0,20},
{"OP5 包络速度 R2",0,99,0,20,7,0,0,21},
{"OP5 包络速度 R3",0,99,0,21,7,0,0,22},
{"OP5 包络速度 R4",0,99,0,22,7,0,0,23},
{"OP5 包络电平 L1",0,99,0,23,7,0,0,24},
{"OP5 包络电平 L2",0,99,0,24,7,0,0,25},
{"OP5 包络电平 L3",0,99,0,25,7,0,0,26},
{"OP5 包络电平 L4",0,99,0,26,7,0,0,27},
{"OP5 断点",0,99,0,27,7,0,0,28},
{"OP5 左深度",0,99,0,28,7,0,0,29},
{"OP5 右深度",0,99,0,29,7,0,0,30},
{"OP5 左曲线",0,3,0,30,2,0,0,31},
{"OP5 右曲线",0,3,0,30,2,2,0,31},
{"OP5 速度缩放",0,7,0,31,3,0,0,32},
{"OP5 微调",0,14,7,31,4,3,0,32},
{"OP5 振幅灵敏度",0,3,0,32,2,0,0,33},
{"OP5 力度灵敏度",0,7,0,32,3,2,0,33},
{"OP5 输出",0,99,99,33,7,0,0,34},
{"OP5 频率模式",0,1,0,34,1,0,0,35},
{"OP5 粗调",0,31,1,34,5,1,0,35},
{"OP5 细调",0,99,0,35,7,0,0,36},
{"OP4 包络速度 R1",0,99,0,36,7,0,0,37},
{"OP4 包络速度 R2",0,99,0,37,7,0,0,38},
{"OP4 包络速度 R3",0,99,0,38,7,0,0,39},
{"OP4 包络速度 R4",0,99,0,39,7,0,0,40},
{"OP4 包络电平 L1",0,99,0,40,7,0,0,41},
{"OP4 包络电平 L2",0,99,0,41,7,0,0,42},
{"OP4 包络电平 L3",0,99,0,42,7,0,0,43},
{"OP4 包络电平 L4",0,99,0,43,7,0,0,44},
{"OP4 断点",0,99,0,44,7,0,0,45},
{"OP4 左深度",0,99,0,45,7,0,0,46},
{"OP4 右深度",0,99,0,46,7,0,0,47},
{"OP4 左曲线",0,3,0,47,2,0,0,48},
{"OP4 右曲线",0,3,0,47,2,2,0,48},
{"OP4 速度缩放",0,7,0,48,3,0,0,49},
{"OP4 微调",0,14,7,48,4,3,0,49},
{"OP4 振幅灵敏度",0,3,0,49,2,0,0,50},
{"OP4 力度灵敏度",0,7,0,49,3,2,0,50},
{"OP4 输出",0,99,99,50,7,0,0,51},
{"OP4 频率模式",0,1,0,51,1,0,0,52},
{"OP4 粗调",0,31,1,51,5,1,0,52},
{"OP4 细调",0,99,0,52,7,0,0,53},
{"OP3 包络速度 R1",0,99,0,53,7,0,0,54},
{"OP3 包络速度 R2",0,99,0,54,7,0,0,55},
{"OP3 包络速度 R3",0,99,0,55,7,0,0,56},
{"OP3 包络速度 R4",0,99,0,56,7,0,0,57},
{"OP3 包络电平 L1",0,99,0,57,7,0,0,58},
{"OP3 包络电平 L2",0,99,0,58,7,0,0,59},
{"OP3 包络电平 L3",0,99,0,59,7,0,0,60},
{"OP3 包络电平 L4",0,99,0,60,7,0,0,61},
{"OP3 断点",0,99,0,61,7,0,0,62},
{"OP3 左深度",0,99,0,62,7,0,0,63},
{"OP3 右深度",0,99,0,63,7,0,0,64},
{"OP3 左曲线",0,3,0,64,2,0,0,65},
{"OP3 右曲线",0,3,0,64,2,2,0,65},
{"OP3 速度缩放",0,7,0,65,3,0,0,66},
{"OP3 微调",0,14,7,65,4,3,0,66},
{"OP3 振幅灵敏度",0,3,0,66,2,0,0,67},
{"OP3 力度灵敏度",0,7,0,66,3,2,0,67},
{"OP3 输出",0,99,99,67,7,0,0,68},
{"OP3 频率模式",0,1,0,68,1,0,0,69},
{"OP3 粗调",0,31,1,68,5,1,0,69},
{"OP3 细调",0,99,0,69,7,0,0,70},
{"OP2 包络速度 R1",0,99,0,70,7,0,0,71},
{"OP2 包络速度 R2",0,99,0,71,7,0,0,72},
{"OP2 包络速度 R3",0,99,0,72,7,0,0,73},
{"OP2 包络速度 R4",0,99,0,73,7,0,0,74},
{"OP2 包络电平 L1",0,99,0,74,7,0,0,75},
{"OP2 包络电平 L2",0,99,0,75,7,0,0,76},
{"OP2 包络电平 L3",0,99,0,76,7,0,0,77},
{"OP2 包络电平 L4",0,99,0,77,7,0,0,78},
{"OP2 断点",0,99,0,78,7,0,0,79},
{"OP2 左深度",0,99,0,79,7,0,0,80},
{"OP2 右深度",0,99,0,80,7,0,0,81},
{"OP2 左曲线",0,3,0,81,2,0,0,82},
{"OP2 右曲线",0,3,0,81,2,2,0,82},
{"OP2 速度缩放",0,7,0,82,3,0,0,83},
{"OP2 微调",0,14,7,82,4,3,0,83},
{"OP2 振幅灵敏度",0,3,0,83,2,0,0,84},
{"OP2 力度灵敏度",0,7,0,83,3,2,0,84},
{"OP2 输出",0,99,99,84,7,0,0,85},
{"OP2 频率模式",0,1,0,85,1,0,0,86},
{"OP2 粗调",0,31,1,85,5,1,0,86},
{"OP2 细调",0,99,0,86,7,0,0,87},
{"OP1 包络速度 R1",0,99,0,87,7,0,0,88},
{"OP1 包络速度 R2",0,99,0,88,7,0,0,89},
{"OP1 包络速度 R3",0,99,0,89,7,0,0,90},
{"OP1 包络速度 R4",0,99,0,90,7,0,0,91},
{"OP1 包络电平 L1",0,99,0,91,7,0,0,92},
{"OP1 包络电平 L2",0,99,0,92,7,0,0,93},
{"OP1 包络电平 L3",0,99,0,93,7,0,0,94},
{"OP1 包络电平 L4",0,99,0,94,7,0,0,95},
{"OP1 断点",0,99,0,95,7,0,0,96},
{"OP1 左深度",0,99,0,96,7,0,0,97},
{"OP1 右深度",0,99,0,97,7,0,0,98},
{"OP1 左曲线",0,3,0,98,2,0,0,99},
{"OP1 右曲线",0,3,0,98,2,2,0,99},
{"OP1 速度缩放",0,7,0,99,3,0,0,100},
{"OP1 微调",0,14,7,99,4,3,0,100},
{"OP1 振幅灵敏度",0,3,0,100,2,0,0,101},
{"OP1 力度灵敏度",0,7,0,100,3,2,0,101},
{"OP1 输出",0,99,99,101,7,0,0,102},
{"OP1 频率模式",0,1,0,102,1,0,0,103},
{"OP1 粗调",0,31,1,102,5,1,0,103},
{"OP1 细调",0,99,0,103,7,0,0,104},
{"音高包络 R1",0,99,0,104,7,0,0,105},
{"音高包络 R2",0,99,0,105,7,0,0,106},
{"音高包络 R3",0,99,0,106,7,0,0,107},
{"音高包络 R4",0,99,0,107,7,0,0,108},
{"音高包络 L1",0,99,0,108,7,0,0,109},
{"音高包络 L2",0,99,0,109,7,0,0,110},
{"音高包络 L3",0,99,0,110,7,0,0,111},
{"音高包络 L4",0,99,0,111,7,0,0,112},
{"算法",0,31,0,112,5,0,0,113},
{"反馈",0,7,0,113,3,0,0,114},
{"振荡器同步",0,1,0,113,1,3,0,114},
{"LFO 速度",0,99,0,114,7,0,0,115},
{"LFO 延迟",0,99,0,115,7,0,0,116},
{"LFO 音高深度",0,99,0,116,7,0,0,117},
{"LFO 振幅深度",0,99,0,117,7,0,0,118},
{"LFO 同步",0,1,0,118,1,0,0,119},
{"LFO 波形",0,5,0,118,3,1,0,119},
{"音高灵敏度",0,7,0,118,3,4,0,119},
{"移调",0,48,24,119,7,0,0,120},
{"名称字符 1 (ASCII)",32,126,32,120,7,0,0,121},
{"名称字符 2 (ASCII)",32,126,32,121,7,0,0,122},
{"名称字符 3 (ASCII)",32,126,32,122,7,0,0,123},
{"名称字符 4 (ASCII)",32,126,32,123,7,0,0,124},
{"名称字符 5 (ASCII)",32,126,32,124,7,0,0,125},
{"名称字符 6 (ASCII)",32,126,32,125,7,0,0,126},
{"名称字符 7 (ASCII)",32,126,32,126,7,0,0,127},
{"名称字符 8 (ASCII)",32,126,32,127,7,0,0,128},
{"名称字符 9 (ASCII)",32,126,32,128,7,0,0,129},
{"名称字符 10 (ASCII)",32,126,32,129,7,0,0,130},
};
static const fm1_action_field_t fields_21[] = {
{.name=""},
};
static const fm1_action_field_t fields_22[] = {
{"段落数量",0,16,1,1,7,0,0,2},
{"段落 1 · T1 工程 (4静音)",0,4,0,2,7,0,0,6},
{"段落 1 · T2 工程 (4静音)",0,4,0,3,7,0,0,7},
{"段落 1 · T3 工程 (4静音)",0,4,0,4,7,0,0,8},
{"段落 1 · T4 工程 (4静音)",0,4,0,5,7,0,0,9},
{"段落 1 · 重复",1,16,1,6,7,0,0,10},
{"段落 2 · T1 工程 (4静音)",0,4,0,7,7,0,0,11},
{"段落 2 · T2 工程 (4静音)",0,4,0,8,7,0,0,12},
{"段落 2 · T3 工程 (4静音)",0,4,0,9,7,0,0,13},
{"段落 2 · T4 工程 (4静音)",0,4,0,10,7,0,0,14},
{"段落 2 · 重复",1,16,1,11,7,0,0,15},
{"段落 3 · T1 工程 (4静音)",0,4,0,12,7,0,0,16},
{"段落 3 · T2 工程 (4静音)",0,4,0,13,7,0,0,17},
{"段落 3 · T3 工程 (4静音)",0,4,0,14,7,0,0,18},
{"段落 3 · T4 工程 (4静音)",0,4,0,15,7,0,0,19},
{"段落 3 · 重复",1,16,1,16,7,0,0,20},
{"段落 4 · T1 工程 (4静音)",0,4,0,17,7,0,0,21},
{"段落 4 · T2 工程 (4静音)",0,4,0,18,7,0,0,22},
{"段落 4 · T3 工程 (4静音)",0,4,0,19,7,0,0,23},
{"段落 4 · T4 工程 (4静音)",0,4,0,20,7,0,0,24},
{"段落 4 · 重复",1,16,1,21,7,0,0,25},
{"段落 5 · T1 工程 (4静音)",0,4,0,22,7,0,0,26},
{"段落 5 · T2 工程 (4静音)",0,4,0,23,7,0,0,27},
{"段落 5 · T3 工程 (4静音)",0,4,0,24,7,0,0,28},
{"段落 5 · T4 工程 (4静音)",0,4,0,25,7,0,0,29},
{"段落 5 · 重复",1,16,1,26,7,0,0,30},
{"段落 6 · T1 工程 (4静音)",0,4,0,27,7,0,0,31},
{"段落 6 · T2 工程 (4静音)",0,4,0,28,7,0,0,32},
{"段落 6 · T3 工程 (4静音)",0,4,0,29,7,0,0,33},
{"段落 6 · T4 工程 (4静音)",0,4,0,30,7,0,0,34},
{"段落 6 · 重复",1,16,1,31,7,0,0,35},
{"段落 7 · T1 工程 (4静音)",0,4,0,32,7,0,0,36},
{"段落 7 · T2 工程 (4静音)",0,4,0,33,7,0,0,37},
{"段落 7 · T3 工程 (4静音)",0,4,0,34,7,0,0,38},
{"段落 7 · T4 工程 (4静音)",0,4,0,35,7,0,0,39},
{"段落 7 · 重复",1,16,1,36,7,0,0,40},
{"段落 8 · T1 工程 (4静音)",0,4,0,37,7,0,0,41},
{"段落 8 · T2 工程 (4静音)",0,4,0,38,7,0,0,42},
{"段落 8 · T3 工程 (4静音)",0,4,0,39,7,0,0,43},
{"段落 8 · T4 工程 (4静音)",0,4,0,40,7,0,0,44},
{"段落 8 · 重复",1,16,1,41,7,0,0,45},
{"段落 9 · T1 工程 (4静音)",0,4,0,42,7,0,0,46},
{"段落 9 · T2 工程 (4静音)",0,4,0,43,7,0,0,47},
{"段落 9 · T3 工程 (4静音)",0,4,0,44,7,0,0,48},
{"段落 9 · T4 工程 (4静音)",0,4,0,45,7,0,0,49},
{"段落 9 · 重复",1,16,1,46,7,0,0,50},
{"段落 10 · T1 工程 (4静音)",0,4,0,47,7,0,0,51},
{"段落 10 · T2 工程 (4静音)",0,4,0,48,7,0,0,52},
{"段落 10 · T3 工程 (4静音)",0,4,0,49,7,0,0,53},
{"段落 10 · T4 工程 (4静音)",0,4,0,50,7,0,0,54},
{"段落 10 · 重复",1,16,1,51,7,0,0,55},
{"段落 11 · T1 工程 (4静音)",0,4,0,52,7,0,0,56},
{"段落 11 · T2 工程 (4静音)",0,4,0,53,7,0,0,57},
{"段落 11 · T3 工程 (4静音)",0,4,0,54,7,0,0,58},
{"段落 11 · T4 工程 (4静音)",0,4,0,55,7,0,0,59},
{"段落 11 · 重复",1,16,1,56,7,0,0,60},
{"段落 12 · T1 工程 (4静音)",0,4,0,57,7,0,0,61},
{"段落 12 · T2 工程 (4静音)",0,4,0,58,7,0,0,62},
{"段落 12 · T3 工程 (4静音)",0,4,0,59,7,0,0,63},
{"段落 12 · T4 工程 (4静音)",0,4,0,60,7,0,0,64},
{"段落 12 · 重复",1,16,1,61,7,0,0,65},
{"段落 13 · T1 工程 (4静音)",0,4,0,62,7,0,0,66},
{"段落 13 · T2 工程 (4静音)",0,4,0,63,7,0,0,67},
{"段落 13 · T3 工程 (4静音)",0,4,0,64,7,0,0,68},
{"段落 13 · T4 工程 (4静音)",0,4,0,65,7,0,0,69},
{"段落 13 · 重复",1,16,1,66,7,0,0,70},
{"段落 14 · T1 工程 (4静音)",0,4,0,67,7,0,0,71},
{"段落 14 · T2 工程 (4静音)",0,4,0,68,7,0,0,72},
{"段落 14 · T3 工程 (4静音)",0,4,0,69,7,0,0,73},
{"段落 14 · T4 工程 (4静音)",0,4,0,70,7,0,0,74},
{"段落 14 · 重复",1,16,1,71,7,0,0,75},
{"段落 15 · T1 工程 (4静音)",0,4,0,72,7,0,0,76},
{"段落 15 · T2 工程 (4静音)",0,4,0,73,7,0,0,77},
{"段落 15 · T3 工程 (4静音)",0,4,0,74,7,0,0,78},
{"段落 15 · T4 工程 (4静音)",0,4,0,75,7,0,0,79},
{"段落 15 · 重复",1,16,1,76,7,0,0,80},
{"段落 16 · T1 工程 (4静音)",0,4,0,77,7,0,0,81},
{"段落 16 · T2 工程 (4静音)",0,4,0,78,7,0,0,82},
{"段落 16 · T3 工程 (4静音)",0,4,0,79,7,0,0,83},
{"段落 16 · T4 工程 (4静音)",0,4,0,80,7,0,0,84},
{"段落 16 · 重复",1,16,1,81,7,0,0,85},
};
static const fm1_action_field_t fields_23[] = {
{.name=""},
};
static const fm1_action_field_t fields_24[] = {
{.name=""},
};
static const fm1_action_field_t fields_25[] = {
{"轨道 (0–3)",0,3,0,0,7,0,0,-1},
};
static const fm1_action_field_t fields_26[] = {
{"轨道 (0–3)",0,3,0,0,7,0,0,-1},
{"启用",0,1,1,2,7,0,0,2},
};
static const fm1_action_field_t fields_27[] = {
{"轨道 (0–3)",0,3,0,0,7,0,0,-1},
};
static const fm1_action_field_t fields_28[] = {
{"轨道 (0–3)",0,3,0,0,7,0,0,-1},
{"步进",0,63,0,2,7,0,0,-1},
{"参数 ID",0,110,0,3,7,0,0,-1},
{"参数值",-64,127,0,4,14,0,8192,-1},
};
static const fm1_action_field_t fields_29[] = {
{"轨道 (0–3)",0,3,0,0,7,0,0,-1},
{"步进",0,63,0,2,7,0,0,-1},
{"参数 ID",0,110,0,3,7,0,0,-1},
{"参数值",-64,127,0,4,14,0,8192,-1},
};
static const fm1_action_field_t fields_30[] = {
{"轨道 (0–3)",0,3,0,0,7,0,0,-1},
{"步进",0,63,0,2,7,0,0,-1},
{"参数 ID",0,110,0,3,7,0,0,-1},
};
static const fm1_action_field_t fields_31[] = {
{"轨道 (0–3)",0,3,0,0,7,0,0,-1},
{"步进 (127全部)",0,127,0,2,7,0,0,-1},
};
static const fm1_action_field_t fields_32[] = {
{.name=""},
};
static const fm1_action_field_t fields_33[] = {
{"CC",0,127,74,1,7,0,0,-1},
{"轨道 (0–3)",0,3,0,2,7,0,0,-1},
{"参数 ID",0,110,0,3,7,0,0,-1},
};
static const fm1_action_field_t fields_34[] = {
{"CC",0,127,74,1,7,0,0,-1},
};
static const fm1_action_field_t fields_35[] = {
{.name=""},
};
static const fm1_action_field_t fields_36[] = {
{.name=""},
};
static const fm1_action_field_t fields_37[] = {
{.name=""},
};
static const fm1_action_field_t fields_38[] = {
{"引擎 (用户库用引擎总数)",0,32,0,0,7,0,0,-1},
{"起始预设",0,127,0,1,14,0,8192,-1},
{"数量",1,32,16,3,7,0,0,-1},
};
static const fm1_action_field_t fields_39[] = {
{"引擎",0,32,0,0,7,0,0,1},
{"预设",0,127,0,1,14,0,8192,2},
{"收藏",0,1,1,3,7,0,0,4},
};
static const fm1_action_field_t fields_40[] = {
{"仅显示收藏",0,1,0,1,7,0,0,2},
};
static const fm1_action_field_t fields_41[] = {
{"背景 R",0,31,16,1,7,0,0,2},
{"背景 G",0,63,16,2,7,0,0,3},
{"背景 B",0,31,16,3,7,0,0,4},
{"表面 R",0,31,16,4,7,0,0,5},
{"表面 G",0,63,16,5,7,0,0,6},
{"表面 B",0,31,16,6,7,0,0,7},
{"文字 R",0,31,16,7,7,0,0,8},
{"文字 G",0,63,16,8,7,0,0,9},
{"文字 B",0,31,16,9,7,0,0,10},
{"主题 R",0,31,16,10,7,0,0,11},
{"主题 G",0,63,16,11,7,0,0,12},
{"主题 B",0,31,16,12,7,0,0,13},
{"强调 R",0,31,16,13,7,0,0,14},
{"强调 G",0,63,16,14,7,0,0,15},
{"强调 B",0,31,16,15,7,0,0,16},
};
static const fm1_action_field_t fields_42[] = {
{"背景 R",0,31,16,1,7,0,0,2},
{"背景 G",0,63,16,2,7,0,0,3},
{"背景 B",0,31,16,3,7,0,0,4},
{"表面 R",0,31,16,4,7,0,0,5},
{"表面 G",0,63,16,5,7,0,0,6},
{"表面 B",0,31,16,6,7,0,0,7},
{"文字 R",0,31,16,7,7,0,0,8},
{"文字 G",0,63,16,8,7,0,0,9},
{"文字 B",0,31,16,9,7,0,0,10},
{"主题 R",0,31,16,10,7,0,0,11},
{"主题 G",0,63,16,11,7,0,0,12},
{"主题 B",0,31,16,12,7,0,0,13},
{"强调 R",0,31,16,13,7,0,0,14},
{"强调 G",0,63,16,14,7,0,0,15},
{"强调 B",0,31,16,15,7,0,0,16},
};
static const fm1_action_field_t fields_43[] = {
{.name=""},
};
static const fm1_action_field_t fields_44[] = {
{.name=""},
};
static const fm1_action_field_t fields_45[] = {
{"步进 (0–63)",0,63,0,0,7,0,0,0},
{"鼓轨 1 · 开启",0,1,0,1,1,0,0,1},
{"鼓轨 1 · 电平",0,3,0,4,2,0,0,4},
{"鼓轨 1 · 连击",0,3,0,9,2,0,0,9},
{"鼓轨 2 · 开启",0,1,0,1,1,1,0,1},
{"鼓轨 2 · 电平",0,3,0,4,2,2,0,4},
{"鼓轨 2 · 连击",0,3,0,9,2,2,0,9},
{"鼓轨 3 · 开启",0,1,0,1,1,2,0,1},
{"鼓轨 3 · 电平",0,3,0,4,2,4,0,4},
{"鼓轨 3 · 连击",0,3,0,9,2,4,0,9},
{"鼓轨 4 · 开启",0,1,0,1,1,3,0,1},
{"鼓轨 4 · 电平",0,3,0,4,2,6,0,4},
{"鼓轨 4 · 连击",0,3,0,9,2,6,0,9},
{"鼓轨 5 · 开启",0,1,0,1,1,4,0,1},
{"鼓轨 5 · 电平",0,3,0,4,2,8,0,4},
{"鼓轨 5 · 连击",0,3,0,9,2,8,0,9},
{"鼓轨 6 · 开启",0,1,0,1,1,5,0,1},
{"鼓轨 6 · 电平",0,3,0,4,2,10,0,4},
{"鼓轨 6 · 连击",0,3,0,9,2,10,0,9},
{"鼓轨 7 · 开启",0,1,0,1,1,6,0,1},
{"鼓轨 7 · 电平",0,3,0,4,2,12,0,4},
{"鼓轨 7 · 连击",0,3,0,9,2,12,0,9},
{"鼓轨 8 · 开启",0,1,0,1,1,7,0,1},
{"鼓轨 8 · 电平",0,3,0,4,2,14,0,4},
{"鼓轨 8 · 连击",0,3,0,9,2,14,0,9},
{"鼓轨 9 · 开启",0,1,0,1,1,8,0,1},
{"鼓轨 9 · 电平",0,3,0,4,2,16,0,4},
{"鼓轨 9 · 连击",0,3,0,9,2,16,0,9},
{"鼓轨 10 · 开启",0,1,0,1,1,9,0,1},
{"鼓轨 10 · 电平",0,3,0,4,2,18,0,4},
{"鼓轨 10 · 连击",0,3,0,9,2,18,0,9},
{"鼓轨 11 · 开启",0,1,0,1,1,10,0,1},
{"鼓轨 11 · 电平",0,3,0,4,2,20,0,4},
{"鼓轨 11 · 连击",0,3,0,9,2,20,0,9},
{"鼓轨 12 · 开启",0,1,0,1,1,11,0,1},
{"鼓轨 12 · 电平",0,3,0,4,2,22,0,4},
{"鼓轨 12 · 连击",0,3,0,9,2,22,0,9},
{"鼓轨 13 · 开启",0,1,0,1,1,12,0,1},
{"鼓轨 13 · 电平",0,3,0,4,2,24,0,4},
{"鼓轨 13 · 连击",0,3,0,9,2,24,0,9},
{"鼓轨 14 · 开启",0,1,0,1,1,13,0,1},
{"鼓轨 14 · 电平",0,3,0,4,2,26,0,4},
{"鼓轨 14 · 连击",0,3,0,9,2,26,0,9},
{"鼓轨 15 · 开启",0,1,0,1,1,14,0,1},
{"鼓轨 15 · 电平",0,3,0,4,2,28,0,4},
{"鼓轨 15 · 连击",0,3,0,9,2,28,0,9},
{"鼓轨 16 · 开启",0,1,0,1,1,15,0,1},
{"鼓轨 16 · 电平",0,3,0,4,2,30,0,4},
{"鼓轨 16 · 连击",0,3,0,9,2,30,0,9},
};
static const fm1_action_field_t fields_46[] = {
{"轨道 (0–3)",0,3,0,0,7,0,0,-1},
};
static const fm1_action_field_t fields_47[] = {
{"轨道 (0–3)",0,3,0,0,7,0,0,0},
{"步进 (0–63)",0,63,0,1,7,0,0,1},
{"参数 ID",0,57,0,2,7,0,0,2},
{"参数值",-8192,8191,0,3,14,0,8192,5},
};
static const fm1_action_field_t fields_48[] = {
{"轨道 (0–3)",0,3,0,0,7,0,0,0},
{"步进 (0–63)",0,63,0,1,7,0,0,1},
{"参数 ID",0,57,0,2,7,0,0,2},
};
static const fm1_action_field_t fields_49[] = {
{"轨道 (0–3)",0,3,0,0,7,0,0,-1},
};
static const fm1_action_field_t fields_50[] = {
{"轨道 (0–3)",0,3,0,0,7,0,0,0},
{"步进 (0–63)",0,63,0,1,7,0,0,1},
{"微时序 / 64",-32,31,0,2,7,0,64,2},
};
static const fm1_action_field_t fields_51[] = {
{"轨道 (0–3)",0,3,0,0,7,0,0,-1},
};
static const fm1_action_field_t fields_52[] = {
{"轨道 (0–3)",0,3,0,0,7,0,0,0},
{"步进 (0–63)",0,63,0,1,7,0,0,1},
{"条件 · 0正常 1填充 2非填充",0,2,0,2,7,0,0,2},
};
static const fm1_action_field_t fields_53[] = {
{.name=""},
};
static const fm1_action_field_t fields_54[] = {
{.name=""},
};
static const fm1_action_field_t fields_55[] = {
{"用户套件",0,3,0,0,7,0,0,0},
{"鼓轨",0,15,0,1,7,0,0,1},
{"力度",1,127,96,2,7,0,0,-1},
};
static const fm1_action_field_t fields_56[] = {
{"用户套件",0,3,0,0,7,0,0,0},
{"工厂套件",0,31,0,3,7,0,0,-1},
};
static const fm1_action_field_t fields_57[] = {
{.name=""},
};
static const fm1_action_field_t fields_58[] = {
{"0停止 1播放 2切换",0,2,0,1,7,0,0,-1},
};
static const fm1_action_field_t fields_59[] = {
{"层 · 5SEL 6GLO 7SAVE",5,7,6,1,7,0,0,-1},
{"白键",0,15,0,2,7,0,0,-1},
{"1按下 0松开",0,1,0,3,7,0,0,-1},
};
static const fm1_action_field_t fields_60[] = {
{"效果",0,26,0,1,7,0,0,-1},
{"1开启 0关闭",0,1,0,2,7,0,0,-1},
};
static const fm1_action_field_t fields_61[] = {
{.name=""},
};
static const fm1_action_field_t fields_62[] = {
{"0撤销 1重做",0,1,0,1,7,0,0,-1},
};
static const fm1_action_field_t fields_63[] = {
{"轨道 (0–3)",0,3,0,1,7,0,0,-1},
{"音符 / 鼓轨",0,127,60,2,7,0,0,-1},
{"电平 · 0正常 1幽灵 2轻 3重",0,3,0,3,7,0,0,-1},
{"1按下 0松开",0,1,0,4,7,0,0,-1},
};
static const fm1_action_field_t fields_64[] = {
{"轨道 (0–3)",0,3,0,1,7,0,0,-1},
{"音符 / 鼓轨",0,127,60,2,7,0,0,-1},
{"1按下 0松开",0,1,0,3,7,0,0,-1},
};
static const fm1_action_field_t fields_65[] = {
{"轨道 (0–3)",0,3,0,1,7,0,0,-1},
{"0旋转 1长度 2移调",0,2,0,2,7,0,0,-1},
{"1增加 0减少",0,1,0,3,7,0,0,-1},
};
static const fm1_action_field_t fields_66[] = {
{"段落数量 (0结束)",0,8,0,1,7,0,0,-1},
{"段落 1",0,3,0,2,7,0,0,-1},
{"段落 2",0,3,0,3,7,0,0,-1},
{"段落 3",0,3,0,4,7,0,0,-1},
{"段落 4",0,3,0,5,7,0,0,-1},
{"段落 5",0,3,0,6,7,0,0,-1},
{"段落 6",0,3,0,7,7,0,0,-1},
{"段落 7",0,3,0,8,7,0,0,-1},
{"段落 8",0,3,0,9,7,0,0,-1},
};
static const fm1_action_field_t fields_67[] = {
{"混响",0,1,0,1,1,0,0,-1},
{"回声",0,1,0,1,1,1,0,-1},
};
static const fm1_action_field_t fields_68[] = {
{"音量 (127交还旋钮)",0,127,127,1,7,0,0,-1},
};
static const fm1_action_field_t fields_69[] = {
{"鼓轨",0,15,0,1,7,0,0,-1},
{"音高",-8,7,0,2,7,0,8,-1},
{"衰减",-4,3,0,3,7,0,4,-1},
};
static const fm1_action_field_t fields_70[] = {
{"套件 · 0–31工厂 / 64–67用户",0,67,64,0,7,0,0,-1},
};
static const fm1_action_field_t fields_71[] = {
{.name=""},
};
static const fm1_action_field_t fields_72[] = {
{.name=""},
};
static const fm1_action_field_t fields_73[] = {
{.name=""},
};
static const fm1_action_field_t fields_74[] = {
{.name=""},
};
static const fm1_action_field_t fields_75[] = {
{.name=""},
};
static const fm1_action_field_t fields_76[] = {
{.name=""},
};
static const fm1_action_field_t fields_77[] = {
{"名称字符 1 (ASCII)",32,126,32,0,7,0,0,0},
{"名称字符 2 (ASCII)",32,126,32,1,7,0,0,1},
{"名称字符 3 (ASCII)",32,126,32,2,7,0,0,2},
{"名称字符 4 (ASCII)",32,126,32,3,7,0,0,3},
{"名称字符 5 (ASCII)",32,126,32,4,7,0,0,4},
{"名称字符 6 (ASCII)",32,126,32,5,7,0,0,5},
{"名称字符 7 (ASCII)",32,126,32,6,7,0,0,6},
{"名称字符 8 (ASCII)",32,126,32,7,7,0,0,7},
{"名称字符 9 (ASCII)",32,126,32,8,7,0,0,8},
{"名称字符 10 (ASCII)",32,126,32,9,7,0,0,9},
{"名称字符 11 (ASCII)",32,126,32,10,7,0,0,10},
{"名称字符 12 (ASCII)",32,126,32,11,7,0,0,11},
};
static const fm1_action_field_t fields_78[] = {
{.name=""},
};
static const fm1_action_field_t fields_79[] = {
{.name=""},
};
static const fm1_action_field_t fields_80[] = {
{.name=""},
};
static const fm1_action_field_t fields_81[] = {
{.name=""},
};
static const fm1_action_field_t fields_82[] = {
{.name=""},
};
static const fm1_action_field_t fields_83[] = {
{.name=""},
};
static const fm1_action_field_t fields_84[] = {
{.name=""},
};
static const fm1_action_field_t fields_85[] = {
{.name=""},
};
static const fm1_action_field_t fields_86[] = {
{"页 · 1状态 2–4发送缓冲",1,4,1,0,7,0,0,0},
};
static const action_definition_t definitions[] = {
{(1u << FW_FELUCCA),"轨道 · 电平与静音",28,28,4,1,-1,-1,true,"",3,
{},{},fields_0},
{(1u << FW_FELUCCA),"编排 · 单步音符与条件",30,30,17,2,-1,-1,true,"",31,
{},{},fields_1},
{(1u << FW_SLOOP),"轨道 · 电平与静音",28,28,4,1,-1,-1,true,"",3,
{},{},fields_2},
{(1u << FW_SLOOP),"编排 · 单步音符与条件",30,30,13,2,-1,-1,true,"sloop_step",19,
{},{},fields_3},
{(1u << FW_JANGADA),"轨道 · 电平与静音",28,28,4,1,-1,-1,true,"",3,
{},{},fields_4},
{(1u << FW_JANGADA),"编排 · 单步音符与条件",30,30,10,2,-1,-1,true,"",11,
{},{},fields_5},
{(1u << FW_FELUCCA) | (1u << FW_SLOOP) | (1u << FW_JANGADA),"音色 · 载入工厂预设",8,0,2,0,-1,-1,true,"",2,
{},{},fields_6},
{(1u << FW_FELUCCA) | (1u << FW_SLOOP) | (1u << FW_JANGADA),"音色 · 工厂预设目录",10,0,1,0,-1,-1,false,"",1,
{},{},fields_7},
{(1u << FW_FELUCCA) | (1u << FW_SLOOP) | (1u << FW_JANGADA),"音色 · 用户预设目录",16,0,2,0,-1,-1,false,"",2,
{},{},fields_8},
{(1u << FW_FELUCCA) | (1u << FW_SLOOP) | (1u << FW_JANGADA),"音色 · 载入用户预设",20,0,1,0,1,-1,true,"",1,
{},{},fields_9},
{(1u << FW_FELUCCA) | (1u << FW_SLOOP) | (1u << FW_JANGADA),"音色 · 清空用户预设",21,0,1,0,1,-1,true,"",1,
{},{},fields_10},
{(1u << FW_FELUCCA) | (1u << FW_SLOOP) | (1u << FW_JANGADA),"音色 · 保存当前声音",19,0,14,0,1,-1,true,"",13,
{},{},fields_11},
{(1u << FW_FELUCCA) | (1u << FW_SLOOP) | (1u << FW_JANGADA),"FM6 · 音色库目录",70,0,0,0,-1,-1,false,"",0,
{},{},fields_12},
{(1u << FW_SLOOP),"FM6 · 清空库槽位",71,0,1,0,1,-1,true,"",1,
{},{},fields_13},
{(1u << FW_JANGADA),"FM6 · 清空库槽位",71,0,1,0,1,-1,true,"",1,
{},{},fields_14},
{(1u << FW_FELUCCA) | (1u << FW_SLOOP) | (1u << FW_JANGADA) | (1u << FW_X0X),"采样 · 设备槽位目录",15,0,0,0,-1,-1,false,"",0,
{},{},fields_15},
{(1u << FW_FELUCCA) | (1u << FW_SLOOP) | (1u << FW_JANGADA) | (1u << FW_X0X),"连接 · 读取固件信息",1,0,0,0,-1,-1,false,"",0,
{},{},fields_16},
{(1u << FW_FELUCCA) | (1u << FW_SLOOP) | (1u << FW_JANGADA) | (1u << FW_X0X),"连接 · 检查响应",25,0,0,0,-1,-1,false,"",0,
{},{},fields_17},
{(1u << FW_FELUCCA),"FM6 · 六算子编辑",69,68,130,2,2,2,true,"fm6_felucca",157,
{},{},fields_18},
{(1u << FW_SLOOP),"FM6 · 六算子编辑",69,68,130,2,2,2,true,"fm6",157,
{},{},fields_19},
{(1u << FW_JANGADA),"FM6 · 六算子编辑",69,68,130,2,2,2,true,"fm6",157,
{},{},fields_20},
{(1u << FW_FELUCCA),"FM6 · 32声音库目录",77,0,0,0,-1,-1,false,"",0,
{},{},fields_21},
{(1u << FW_FELUCCA),"编排 · 歌曲段落",33,33,82,1,1,1,true,"song",81,
{5},{4},fields_22},
{(1u << FW_FELUCCA),"编排 · 歌曲开始",33,0,1,0,1,-1,true,"",0,
{6},{},fields_23},
{(1u << FW_FELUCCA),"编排 · 歌曲停止",33,0,1,0,1,-1,true,"",0,
{7},{},fields_24},
{(1u << FW_FELUCCA),"自动化 · 读取全部记录",64,0,2,0,1,-1,false,"",1,
{0,8},{},fields_25},
{(1u << FW_FELUCCA),"自动化 · 播放开关",64,0,3,0,1,-1,true,"",2,
{0,1},{},fields_26},
{(1u << FW_FELUCCA),"自动化 · 清空轨道",64,0,2,0,1,-1,true,"",1,
{0,2},{},fields_27},
{(1u << FW_FELUCCA),"自动化 · 设置自动化",64,0,6,0,1,-1,true,"",4,
{0,3},{},fields_28},
{(1u << FW_FELUCCA),"自动化 · 设置参数锁",64,0,6,0,1,-1,true,"",4,
{0,5},{},fields_29},
{(1u << FW_FELUCCA),"自动化 · 删除一条记录",64,0,4,0,1,-1,true,"",3,
{0,4},{},fields_30},
{(1u << FW_FELUCCA),"自动化 · 清除步进参数锁",64,0,3,0,1,-1,true,"",2,
{0,6},{},fields_31},
{(1u << FW_FELUCCA),"MIDI · 学习映射表",78,0,0,0,-1,-1,false,"",0,
{},{},fields_32},
{(1u << FW_FELUCCA),"MIDI · 设置学习映射",79,0,4,0,0,-1,true,"",3,
{0},{},fields_33},
{(1u << FW_FELUCCA),"MIDI · 清除一个映射",79,0,2,0,0,-1,true,"",1,
{1},{},fields_34},
{(1u << FW_FELUCCA),"MIDI · 清除全部映射",79,0,1,0,0,-1,true,"",0,
{2},{},fields_35},
{(1u << FW_FELUCCA),"外观 · 内置配色目录",36,0,0,0,-1,-1,false,"",0,
{},{},fields_36},
{(1u << FW_FELUCCA),"外观 · 当前设置",34,0,0,0,-1,-1,false,"",0,
{},{},fields_37},
{(1u << FW_FELUCCA),"音色 · 收藏列表",37,0,4,0,0,-1,false,"",3,
{},{},fields_38},
{(1u << FW_FELUCCA),"音色 · 收藏开关",38,0,4,0,0,-1,true,"",3,
{},{},fields_39},
{(1u << FW_FELUCCA),"音色 · 收藏筛选",35,0,2,0,0,-1,true,"",1,
{3},{},fields_40},
{(1u << FW_FELUCCA),"外观 · 自定义配色预览",81,80,16,0,0,-1,true,"",15,
{0},{},fields_41},
{(1u << FW_FELUCCA),"外观 · 自定义配色保存",81,80,16,0,0,-1,true,"",15,
{1},{},fields_42},
{(1u << FW_FELUCCA),"外观 · 删除自定义配色",81,0,1,0,0,-1,true,"",0,
{2},{},fields_43},
{(1u << FW_FELUCCA),"外观 · 结束配色预览",81,0,1,0,0,-1,true,"",0,
{3},{},fields_44},
{(1u << FW_SLOOP),"编排 · 十六鼓轨步进",33,33,14,1,-1,-1,true,"",49,
{},{},fields_45},
{(1u << FW_SLOOP),"编排 · 参数锁列表",37,0,1,0,-1,-1,false,"",1,
{},{},fields_46},
{(1u << FW_SLOOP),"编排 · 设置参数锁",38,0,5,0,3,-1,true,"",4,
{},{},fields_47},
{(1u << FW_SLOOP),"编排 · 删除参数锁",38,0,3,0,3,-1,true,"",3,
{},{},fields_48},
{(1u << FW_SLOOP),"编排 · 微时序列表",39,0,1,0,-1,-1,false,"",1,
{},{},fields_49},
{(1u << FW_SLOOP),"编排 · 设置微时序",40,0,3,0,-1,-1,true,"",3,
{},{},fields_50},
{(1u << FW_SLOOP),"编排 · 填充条件列表",41,0,1,0,-1,-1,false,"",1,
{},{},fields_51},
{(1u << FW_SLOOP),"编排 · 设置填充条件",42,0,3,0,-1,-1,true,"",3,
{},{},fields_52},
{(1u << FW_SLOOP),"鼓合成 · 套件目录",72,0,0,0,-1,-1,false,"",0,
{},{},fields_53},
{(1u << FW_SLOOP),"鼓合成 · 保存全部用户套件",75,0,0,0,0,-1,true,"",0,
{},{},fields_54},
{(1u << FW_SLOOP),"鼓合成 · 试听声音",76,0,3,0,2,-1,true,"",3,
{},{},fields_55},
{(1u << FW_SLOOP),"鼓合成 · 从工厂套件初始化",74,0,4,0,2,-1,true,"",2,
{0,17,0},{},fields_56},
{(1u << FW_SLOOP),"LIVE · 当前演奏状态",77,0,1,0,-1,-1,false,"",0,
{0},{},fields_57},
{(1u << FW_SLOOP),"LIVE · 播放",77,0,2,0,-1,-1,true,"",1,
{1},{},fields_58},
{(1u << FW_SLOOP),"LIVE · 面板层按键",77,0,4,0,-1,-1,true,"",3,
{2},{},fields_59},
{(1u << FW_SLOOP),"LIVE · 效果切入",77,0,3,0,-1,-1,true,"",2,
{3},{},fields_60},
{(1u << FW_SLOOP),"LIVE · 录音切换",77,0,2,0,-1,-1,true,"",0,
{4,0},{},fields_61},
{(1u << FW_SLOOP),"LIVE · 撤销与重做",77,0,2,0,-1,-1,true,"",1,
{5},{},fields_62},
{(1u << FW_SLOOP),"LIVE · 连奏",77,0,5,0,-1,-1,true,"",4,
{6},{},fields_63},
{(1u << FW_SLOOP),"LIVE · 擦除音符",77,0,4,0,-1,-1,true,"",3,
{7},{},fields_64},
{(1u << FW_SLOOP),"LIVE · 图案工具",77,0,4,0,-1,-1,true,"",3,
{8},{},fields_65},
{(1u << FW_SLOOP),"LIVE · 快速段落链",77,0,10,0,-1,-1,true,"chain",9,
{9},{},fields_66},
{(1u << FW_SLOOP),"LIVE · 混响与回声抛送",77,0,2,0,-1,-1,true,"",2,
{10},{},fields_67},
{(1u << FW_SLOOP),"LIVE · 总音量",77,0,2,0,-1,-1,true,"",1,
{11},{},fields_68},
{(1u << FW_SLOOP),"LIVE · 鼓音高与衰减",77,0,4,0,-1,-1,true,"",3,
{12},{},fields_69},
{(1u << FW_SLOOP),"鼓合成 · 读取套件详情",73,0,1,0,1,-1,false,"",1,
{},{},fields_70},
{(1u << FW_OPEN) | (1u << FW_PROBE) | (1u << FW_DIAG),"诊断 · 设备与引擎状态",0,0,0,0,-1,-1,false,"open",0,
{},{},fields_71},
{(1u << FW_OPEN) | (1u << FW_PROBE) | (1u << FW_DIAG),"诊断 · 采样库状态",11,0,0,0,-1,-1,false,"open",0,
{},{},fields_72},
{(1u << FW_OPEN) | (1u << FW_PROBE) | (1u << FW_DIAG),"诊断 · 引擎队列统计",17,0,0,0,-1,-1,false,"open",0,
{},{},fields_73},
{(1u << FW_OPEN) | (1u << FW_PROBE) | (1u << FW_DIAG),"诊断 · 音频渲染统计",18,0,0,0,-1,-1,false,"open",0,
{},{},fields_74},
{(1u << FW_OPEN) | (1u << FW_PROBE) | (1u << FW_DIAG),"诊断 · 音频中断统计",19,0,0,0,-1,-1,false,"open",0,
{},{},fields_75},
{(1u << FW_OPEN) | (1u << FW_PROBE) | (1u << FW_DIAG),"诊断 · 总线状态",20,0,0,0,-1,-1,false,"open",0,
{},{},fields_76},
{(1u << FW_OPEN) | (1u << FW_PROBE) | (1u << FW_DIAG),"工程 · 重命名",10,0,12,0,-1,-1,true,"open",12,
{},{},fields_77},
{(1u << FW_OPEN) | (1u << FW_PROBE) | (1u << FW_DIAG),"录音与传输 · 停止",1,0,0,0,-1,-1,true,"mmc",0,
{},{},fields_78},
{(1u << FW_OPEN) | (1u << FW_PROBE) | (1u << FW_DIAG),"录音与传输 · 播放",2,0,0,0,-1,-1,true,"mmc",0,
{},{},fields_79},
{(1u << FW_OPEN) | (1u << FW_PROBE) | (1u << FW_DIAG),"录音与传输 · 继续",3,0,0,0,-1,-1,true,"mmc",0,
{},{},fields_80},
{(1u << FW_OPEN) | (1u << FW_PROBE) | (1u << FW_DIAG),"录音与传输 · 录音开始",6,0,0,0,-1,-1,true,"mmc",0,
{},{},fields_81},
{(1u << FW_OPEN) | (1u << FW_PROBE) | (1u << FW_DIAG),"录音与传输 · 录音结束",7,0,0,0,-1,-1,true,"mmc",0,
{},{},fields_82},
{(1u << FW_OPEN) | (1u << FW_PROBE) | (1u << FW_DIAG),"录音与传输 · 暂停",9,0,0,0,-1,-1,true,"mmc",0,
{},{},fields_83},
{(1u << FW_PROBE) | (1u << FW_DIAG),"诊断 · 传输校验状态",32,0,0,0,-1,-1,false,"open",0,
{},{},fields_84},
{(1u << FW_PROBE) | (1u << FW_DIAG),"诊断 · 清空传输校验状态",35,0,0,0,-1,-1,true,"open",0,
{},{},fields_85},
{(1u << FW_DIAG),"诊断 · 蓝牙快照",32,0,1,0,-1,-1,false,"open",1,
{},{},fields_86},
};
